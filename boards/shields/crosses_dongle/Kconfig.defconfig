## boards/shields/crosses_dongle/Kconfig.defconfig
```kconfig
if SHIELD_CROSSES_DONGLE

config ZMK_KEYBOARD_NAME
  default "Crosses Dongle"

config ZMK_SPLIT
  default y

config ZMK_SPLIT_ROLE_CENTRAL
  default y

endif
```
